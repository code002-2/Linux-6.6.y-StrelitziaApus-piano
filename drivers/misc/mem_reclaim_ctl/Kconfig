## drivers/misc/mem_reclaim_ctl/Kconfig
```kconfig
config MEM_RECLAIM_CTL
        tristate "memory reclaim control"
        default n
        help
          This driver speed up memory rmap.
```

## drivers/staging/mi_async_reclaim/Kconfig
```kconfig
config MI_ASYNC_RECLAIM
    tristate "support MI_ASYNC_RECLAIM module"
    default n
    help
      async reclaim solves the blocking problem caused by rwsem lock contention of reverse mapping during mem recycling.
```

## drivers/staging/mi_rmap_efficiency/Kconfig
```kconfig
config MI_RMAP_EFFICIENCY
    tristate "support MI_RMAP_EFFICIENCY module"
    default n
    help
        skip __mapcount pages to reduce CPU load caused by reverse mapping during mem recycling.
```
