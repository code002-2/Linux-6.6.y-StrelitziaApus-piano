/dts-v1/;
/plugin/;
#include <dt-bindings/clock/qcom,gcc-tuna.h>
#include <dt-bindings/clock/qcom,camcc-sun.h>
#include <dt-bindings/clock/qcom,cambistmclkcc-sun.h>
#include <dt-bindings/interconnect/qcom,tuna.h>
#include <dt-bindings/interrupt-controller/arm-gic.h>
#include <dt-bindings/regulator/qcom,rpmh-regulator-levels.h>
#include "luming-sm8735-camera-sensor.dtsi"
/ {
	model = "Qualcomm Technologies, Inc. Tuna MTP";
	compatible = "qcom,tuna-mtp", "qcom,tuna", "qcom,tunap-mtp", "qcom,tunap", "qcom,mtp";
        qcom,msm-id = <681 0x10000>, <655 0x10000>;
	qcom,board-id = <8 0>;
	xiaomi,miboard-id = <0x8 0>;
};

