/dts-v1/;
/plugin/;
#include "luming-sde-display.dtsi"
/ {
	model = "Qualcomm Technologies, Inc. Luming based on SM8735";
	compatible = "qcom,tuna-mtp", "qcom,tuna", "qcom,tunap-mtp", "qcom,tunap",
			"qcom,mtp";
	qcom,msm-id = <681 0x10000>, <655 0x10000>;
	qcom,board-id = <8 0>;
	xiaomi,miboard-id = <0x8 0>;
};
