&mdss_mdp {
	dsi_o2_42_02_0a_dsc_cmd: qcom,mdss_dsi_o2_42_02_0a_dsc_cmd {
		qcom,mdss-dsi-panel-name = "xiaomi o2 42 02 0a cmd mode dsc dsi panel";
		qcom,mdss-dsi-panel-type = "dsi_video_mode";
		qcom,mdss-dsi-panel-physical-type = "oled";
		qcom,mdss-dsi-virtual-channel-id = <0>;
		qcom,mdss-dsi-stream = <0>;
		qcom,mdss-dsi-bpp = <30>;
		qcom,mdss-dsi-color-order = "rgb_swap_rgb";
		qcom,mdss-dsi-underflow-color = <0xff>;
		qcom,mdss-dsi-border-color = <0>;
		qcom,dsi-ctrl-num = <0>;
		qcom,dsi-phy-num = <0>;
		qcom,mdss-dsi-traffic-mode = "burst_mode";
		qcom,mdss-dsi-lane-map = "lane_map_0123";
		qcom,mdss-dsi-bllp-eof-power-mode;
		qcom,mdss-dsi-bllp-power-mode;
		qcom,mdss-dsi-lane-0-state;
		qcom,mdss-dsi-lane-1-state;
		qcom,mdss-dsi-lane-2-state;
		qcom,mdss-dsi-lane-3-state;
		qcom,mdss-dsi-dma-trigger = "trigger_sw";
		qcom,mdss-dsi-mdp-trigger = "none";
		qcom,mdss-dsi-reset-sequence =<1 1>, <0 1>, <1 10>;
		qcom,mdss-pan-physical-width-dimension = <701>;
		qcom,mdss-pan-physical-height-dimension = <1558>;
		//qcom,mdss-dsi-te-pin-select = <1>;
		//qcom,mdss-dsi-wr-mem-start = <0x2c>;
		//qcom,mdss-dsi-wr-mem-continue = <0x3c>;
		//qcom,mdss-dsi-te-dcs-command = <1>;
		//qcom,mdss-dsi-te-check-enable;
		//qcom,mdss-dsi-te-using-te-pin;
		qcom,mdss-dsi-tx-eot-append;
		qcom,mdss-dsi-lp11-init;
		qcom,mdss-dsi-bl-inverted-dbv;
		qcom,mdss-dsi-panel-dimming-enabled;
		qcom,bl-update-flag = "delay_until_first_frame";
		//qcom,mdss-dsi-panel-hdr-enabled;
		//qcom,mdss-dsi-panel-hdr-color-primaries = <14500 15500 32000
		//	17000 15500 30000 8000 3000>;
		//qcom,mdss-dsi-panel-peak-brightness = <32000000>;
		//qcom,mdss-dsi-panel-blackness-level = <3230>;
		//qcom,mdss-dsi-dma-schedule-line = <1>;
		//qcom,mdss-dsi-dma-schedule-window = <50>;
		//mi,panel-on-dimming-delay = <120>;

		mi,panel-id = <0x00004F32 0x0042020A>;

		qcom,mdss-dsi-display-timings {
			timing@wqhd_normal_120hz_index_01 {
				#include "dsi-panel-o2-42-02-0a-dsc-cmd-common.dtsi"
				cell-index = <0>;
				qcom,mdss-dsi-panel-framerate = <120>;
				qcom,qsync-mode-min-refresh-rate = <1>;
				qcom,dsi-qsync-mode-avr-step-fps = <120>;

				qcom,mdss-dsi-video-mode;
				qcom,mdss-dsi-on-command = [
					//1440x3200
					39 00 00 40 00 00 06 F0 55 AA 52 08 01
					15 00 00 40 00 00 02 6F 06
					15 00 00 40 00 00 02 C4 01
					39 00 00 40 00 00 06 F0 55 AA 52 08 04
					15 00 00 40 00 00 02 C0 20
					39 00 00 40 00 00 06 F0 55 AA 52 08 00
					15 00 00 40 00 00 02 6F 35
					15 00 00 00 00 00 02 C0 23
					39 00 00 40 00 00 06 F0 55 AA 52 08 06
					39 00 00 40 00 00 06 B2 25 24 36 37 37
					39 00 00 40 00 00 06 B8 21 20 36 37 37
					39 00 00 40 00 00 05 2A 00 00 05 9F
					39 00 00 40 00 00 05 2B 00 00 0C 7F
					39 00 00 40 00 00 03 90 03 43
					39 00 00 40 00 00 13 91 AB A8 00 14 C2 00 02 68 02 2E 00 0A 05 0E 03 D1 10 F0
					15 00 00 40 00 00 02 2F 00
					15 00 00 40 00 00 02 35 00
					39 00 00 40 00 00 03 51 0F FF
					15 00 00 40 00 00 02 6F 04
					39 00 00 40 00 00 03 51 0F FF
					15 00 00 00 00 00 02 53 20
					39 00 00 40 00 00 06 F0 55 AA 52 08 08
					39 00 00 40 00 00 17 C1 8E FF EE FF FF EE FF FF EE FF FF EE FF FF EE FF FF FF 7F FF 0E FF
					15 00 00 40 00 00 02 6F 20
					39 00 00 40 00 00 04 C1 FF FF FF
					15 00 00 40 00 00 02 6F 23
					39 00 00 00 00 00 15 C1 0E FF EE FF FF EE FF FF EE FF FF EE FF FF EE FF FF FF 7F FF
					//OP P1 VGL EN
					39 00 00 40 00 00 06 F0 55 AA 52 08 00
					15 00 00 40 00 00 02 6F 10
					39 00 00 40 00 00 11 B5 00 71 71 71 71 71 00 00 18 2B 00 00 00 18 2B 00
					39 00 00 40 00 00 06 F0 55 AA 52 08 05
					39 00 00 40 00 00 0A C4 02 00 82 AA 00 00 70 00 00
					//op P1
					39 00 00 40 00 00 06 F0 55 AA 52 08 00
					15 00 00 40 00 00 02 6F 1C
					39 00 00 40 00 00 11 BA 01 01 01 01 01 01 00 00 01 01 00 00 00 00 00 00
					15 00 00 40 00 00 02 6F 2C
					39 00 00 40 00 00 11 BA 01 01 01 01 01 03 01 01 01 03 01 01 00 00 00 00
					15 00 00 40 00 00 02 6F 3C
					39 00 00 40 00 00 11 BA 01 01 01 01 01 04 03 03 01 04 03 03 00 00 00 00
					15 00 00 40 00 00 02 6F 4C
					39 00 00 40 00 00 11 BA 01 01 01 01 01 04 03 0B 01 04 03 0B 00 00 00 00
					15 00 00 40 00 00 02 6F 5C
					39 00 00 40 00 00 11 BA 01 01 01 01 01 01 01 01 01 01 01 01 01 01 01 01
					15 00 00 40 00 00 02 6F 6C
					39 00 00 40 00 00 09 BA 00 00 00 00 00 00 00 00
					//qsync supported modify
					15 00 00 40 00 00 02 6F 74
					39 00 00 40 00 00 11 BA 00 01 02 03 04 05 07 09 0B 77 EF 00 03 77 0B 00
					15 00 00 40 00 00 02 6F 84
					39 00 00 40 00 00 11 BA 00 01 02 03 04 05 07 09 0B 77 EF 00 03 77 0B 00
					15 00 00 40 00 00 02 6F 94
					39 00 00 40 00 00 11 BA 00 00 00 00 00 00 00 00 00 00 00 00 00 00 00 00
					15 00 00 40 00 00 02 6F A4
					39 00 00 40 00 00 11 BA 01 01 01 01 00 01 01 01 00 01 01 01 00 00 00 01
					15 00 00 40 00 00 02 6F B4
					39 00 00 40 00 00 05 BA 02 55 95 3E
					15 00 00 40 00 00 02 6F B8
					39 00 00 40 00 00 09 BA 00 00 00 00 00 10 00 00
					15 00 00 40 00 00 02 6F C0
					39 00 00 40 00 00 09 BA 00 00 00 00 00 10 00 00
					15 00 00 40 00 00 02 6F 6E
					39 00 00 40 00 00 03 D1 03 48
					//ap-spr
					//39 00 00 40 00 00 13 91 AB F0 00 14 D1 00 01 DE 00 A3 00 3C 05 7A 15 9A 11 50
                    39 00 00 40 00 00 13 91 AB A8 00 14 C2 00 02 68 02 2E 00 0A 05 0E 03 D1 10 F0
					//39 00 00 40 00 00 06 F0 55 AA 52 08 03
					39 00 00 40 00 00 06 F0 55 AA 52 08 03
					15 00 00 40 00 00 02 6F 09
					39 00 00 40 00 00 07 DE 10 34 25 30 14 25
					39 00 00 40 00 00 06 F0 55 AA 52 08 07
					39 00 00 40 00 00 06 F0 55 AA 52 08 07
					//39 00 00 40 00 00 06 B0 84 44 00 00 40
					39 00 00 40 00 00 06 B0 84 40 00 00 00
					//39 00 00 00 00 00 07 B1 10 00 00 00 10 00
					//round cornor off
					39 00 00 40 00 00 06 F0 55 AA 52 08 07
					15 00 00 00 00 00 02 C0 86
					//vsync tongbu
					39 00 00 40 00 00 06 F0 55 AA 52 08 00
					15 00 00 40 00 00 02 6F 03
					15 00 00 40 00 00 02 BE 4F
					15 00 00 40 00 00 02 6F 0B
					15 00 00 00 00 00 02 BE 02
					//120HZ
					15 00 00 40 00 00 02 2F 30
					15 00 00 00 00 00 02 6D 00
					//fix TE
					15 00 00 40 00 00 02 6F 14
					15 00 00 40 00 00 02 35 66
					15 00 00 40 00 00 02 6F 04
					15 00 00 40 00 00 02 35 00
					15 00 00 00 00 00 02 5A 00
					//51 return in fps
					39 00 00 00 00 00 04 8C 00 00 11
					/*cv switch*/
					39 00 00 40 00 00 06 F0 55 AA 52 08 00
					39 00 00 40 00 00 02 6F 1B
					39 00 00 40 00 00 02 C0 81
					39 00 00 40 00 00 04 2F 32 05 30
					39 00 00 40 00 00 05 3B 00 2B 00 15
					39 00 00 40 00 00 02 6F 04
					39 00 00 40 00 00 05 3B 00 2B 04 55
					39 00 00 40 00 00 06 F0 55 AA 52 08 00
					39 00 00 40 00 00 02 6F 24
					39 00 00 00 00 00 07 C9 0C C0 11 00 0C C0
					39 00 00 00 00 00 02 71 01

					39 00 00 00 00 00 06 F0 55 AA 52 08 00
					15 00 00 00 00 00 02 6F 0D
					15 00 00 00 00 00 02 D8 40

					/* panel esync */
					39 00 00 00 00 00 06 F0 55 AA 52 08 03
					39 00 00 00 00 00 02 6F 06
					39 00 00 00 00 00 02 BA 01

					/* close te */
					39 00 00 00 00 00 02 34 00

					/* esd err ram status */
					39 00 00 00 00 00 06 F0 55 AA 52 08 00
					39 00 00 00 00 00 03 BE 47 45
					15 00 00 00 00 00 02 6F 05
					15 00 00 00 00 00 02 BE 28
					15 00 00 00 00 00 02 6F 19
					39 00 00 00 00 00 05 BE 10 18 00 01

					/* Sleep Out */
					05 00 00 00 78 00 01 11
					/* Display On */
					05 00 00 00 00 00 01 29
				];
				qcom,mdss-dsi-on-command-state = "dsi_lp_mode";

				qcom,mdss-dsi-qsync-freq-step-sequence-interval =
					<0 120000 2>;
				qcom,mdss-dsi-qsync-freq-step-sequence  =
					<60000 1>, <10000 1>;

				qcom,mdss-dsi-sticky_still_en-command =
					[39 01 00 00 00 00 02 18 01];

				qcom,mdss-dsi-sticky_still_disable-command =
					[39 01 00 00 00 00 02 18 00];
				qcom,mdss-dsi-sticky_still_en-command-state = "dsi_hs_mode";
				qcom,mdss-dsi-sticky_still_disable-command-state = "dsi_hs_mode";

				qcom,mdss-dsi-freq-step-pattern1-command =
					[39 01 00 00 00 00 03 51 7F AA];
				qcom,mdss-dsi-freq-step-pattern1-command-state = "dsi_hs_mode";
			};
		};
	};
};

&dsi_o2_42_02_0a_dsc_cmd {
	qcom,panel-supply-entries = <&dsi_panel_pwr_supply_O2>;
	qcom,mdss-dsi-bl-pmic-control-type = "bl_ctrl_dcs";
	qcom,mdss-dsi-bl-min-level = <15>;
	qcom,mdss-dsi-bl-max-level = <16383>;
	qcom,bl-dsc-cmd-state = "dsi_hs_mode";
	qcom,mdss-brightness-max-level = <16383>;
	qcom,mdss-brightness-init-level = <614>;
	qcom,platform-reset-gpio = <&tlmm 98 0>;

	mi,max-brightness-normal = <5460>;

	qcom,mdss-dsi-panel-vsync-delay;
	//qcom,ulps-enabled;
	qcom,dsi-select-clocks = "pll_byte_clk0", "pll_dsi_clk0";

	qcom,mdss-esync;
	qcom,mdss-esync-always-on;
	qcom,mdss-esync-hsync-milli-pulse-width = <500>;
	qcom,mdss-esync-emsync-milli-pulse-width = <500>;
	qcom,mdss-esync-emsync-fps = <120>;

	qcom,qsync-enable;
	qcom,vrr-enable;
	qcom,video-psr-enable;

	qcom,dsi-qsync-avr-disable-hw-trigger;
	qcom,mdss-dsi-qsync-min-refresh-rate = <1>;
	qcom,dsi-qsync-avr-step-fps = <120>;
};
