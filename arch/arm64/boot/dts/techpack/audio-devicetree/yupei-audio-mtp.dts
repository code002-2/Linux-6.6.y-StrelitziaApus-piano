// SPDX-License-Identifier: BSD-3-Clause

/dts-v1/;
/plugin/;

#include "yupei-audio-mtp.dtsi"

/ {
	model = "Qualcomm Technologies, Inc. Tuna MTP";
	compatible = "qcom,tuna-mtp", "qcom,tuna", "qcom,tunap-mtp", "qcom,tunap",
			"qcom,mtp";
	qcom,msm-id = <681 0x10000>, <655 0x10000>, <694 0x10000>;
	qcom,board-id = <8 0>;
	xiaomi,miboard-id = <10 0>;
};
